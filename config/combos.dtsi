/* Sweep positions: Q..P=0..9, A..quote=10..19, Z../=20..29,
 * Esc=30, Backspace=31, Space=32, Enter=33.
 * Glove80 QWERTY combos, adapted to the 34-key alpha block.
 * The default combo timeout is 50 ms, as on the Glove80 custom combos.
 */
compatible = "zmk,combos";
#define COMBO(NAME, BINDINGS, KEYPOS, LAYERS) \
combo_##NAME { \
    bindings = <BINDINGS>; \
    key-positions = <KEYPOS>; \
    layers = <LAYERS>; \
    timeout-ms = <50>; \
};

// Sweep-specific controls remain available.
combo_left_thumbs {
    bindings = <&mo BT_L>;
    key-positions = <30 31>;
    layers = <BASE NAV_L>;
    timeout-ms = <150>;
};
COMBO(right_thumbs, &sl FUN_L, 32 33, BASE NAV_L)
COMBO(hyper, &hyper LG(LS(LA(LCTRL))), 31 32, BASE NAV_L FUN_L)

// Glove80 alpha-key combos; quote substitutes for its home-row semicolon.
COMBO(df, &kp TAB, 12 13, BASE)
COMBO(sd, &kp GRAVE, 11 12, BASE)
COMBO(sdf_escape, &kp ESC, 11 12 13, BASE)
COMBO(as, &skq LSHFT, 10 11, BASE)
COMBO(az_shift, &kp LSHFT, 10 20, BASE)
COMBO(quoteslash_backslash, &kp BSLH, 19 29, BASE NAV_L)
COMBO(lquote, &skq RSHFT, 18 19, BASE)
COMBO(fg, &kp EXCL, 13 14, BASE)
COMBO(hj, &kp QMARK, 15 16, BASE)
COMBO(jk, &kp LA(BSPC), 16 17, BASE)
COMBO(jkl, &kp RET, 16 17 18, BASE)
COMBO(jklquote, &hyper LG(LS(LA(LCTRL))), 16 17 18 19, BASE)
COMBO(asdf_hyper, &hyper LG(LS(LA(LCTRL))), 10 11 12 13, BASE)
COMBO(zslash_caps, &kp CAPSLOCK, 20 29, BASE)
COMBO(jquote, &caps_word, 16 19, BASE)
COMBO(zx, &kp LG(X), 20 21, BASE)
COMBO(xc, &kp LG(C), 21 22, BASE)
COMBO(cv, &kp LG(V), 22 23, BASE)
COMBO(nm_underscore, &kp UNDER, 25 26, BASE)
COMBO(mcomma, &kp MINUS, 26 27, BASE)
COMBO(commadot_equal, &kp EQUAL, 27 28, BASE)
COMBO(dotslash_plus, &kp PLUS, 28 29, BASE)

// Vertical top/home pairs produce 1..0; hold Shift for their symbols.
COMBO(qa_1, &kp N1, 0 10, BASE)
COMBO(ws_2, &kp N2, 1 11, BASE)
COMBO(ed_3, &kp N3, 2 12, BASE)
COMBO(rf_4, &kp N4, 3 13, BASE)
COMBO(tg_5, &kp N5, 4 14, BASE)
COMBO(yh_6, &kp N6, 5 15, BASE)
COMBO(uj_7, &kp N7, 6 16, BASE)
COMBO(ik_8, &kp N8, 7 17, BASE)
COMBO(ol_9, &kp N9, 8 18, BASE)
COMBO(pquote_0, &kp N0, 9 19, BASE)
